## platforms/tab5/components/xiaozhi_core/Kconfig.projbuild
```kconfig
menu "xiaozhi-esp32 configuration"

config OTA_URL
    string "Default OTA URL"
    default "https://api.tenclass.net/xiaozhi/ota/"
    help
        The application will access this URL to check for new firmware and server address.

endmenu
```

## platforms/tab5/sdkconfig.defaults
```kconfig
CONFIG_IDF_TARGET="esp32p4"
CONFIG_SLAVE_IDF_TARGET_ESP32C6=y
CONFIG_ESPTOOLPY_FLASHMODE_QIO=y
CONFIG_ESPTOOLPY_FLASHSIZE_16MB=y
CONFIG_PARTITION_TABLE_CUSTOM=y
CONFIG_COMPILER_OPTIMIZATION_PERF=y
CONFIG_SPIRAM=y
CONFIG_SPIRAM_SPEED_200M=y
CONFIG_SPIRAM_XIP_FROM_PSRAM=y
CONFIG_CACHE_L2_CACHE_256KB=y
CONFIG_CACHE_L2_CACHE_LINE_128B=y
CONFIG_FREERTOS_HZ=1000
CONFIG_FREERTOS_VTASKLIST_INCLUDE_COREID=y
CONFIG_FREERTOS_GENERATE_RUN_TIME_STATS=y
CONFIG_ESP_BROOKESIA_MEMORY_USE_CUSTOM=y
CONFIG_LV_COLOR_SCREEN_TRANSP=y
CONFIG_LV_MEM_CUSTOM=y
CONFIG_LV_MEMCPY_MEMSET_STD=y
CONFIG_LV_DISP_DEF_REFR_PERIOD=25
CONFIG_LV_USE_LOG=y
CONFIG_LV_LOG_PRINTF=y
CONFIG_LV_USE_PERF_MONITOR=y
CONFIG_LV_ATTRIBUTE_FAST_MEM_USE_IRAM=y
CONFIG_LV_FONT_MONTSERRAT_8=y
CONFIG_LV_FONT_MONTSERRAT_10=y
CONFIG_LV_FONT_MONTSERRAT_12=y
CONFIG_LV_FONT_MONTSERRAT_16=y
CONFIG_LV_FONT_MONTSERRAT_18=y
CONFIG_LV_FONT_MONTSERRAT_20=y
CONFIG_LV_FONT_MONTSERRAT_22=y
CONFIG_LV_FONT_MONTSERRAT_24=y
CONFIG_LV_FONT_MONTSERRAT_26=y
CONFIG_LV_FONT_MONTSERRAT_28=y
CONFIG_LV_FONT_MONTSERRAT_30=y
CONFIG_LV_FONT_MONTSERRAT_32=y
CONFIG_LV_FONT_MONTSERRAT_34=y
CONFIG_LV_FONT_MONTSERRAT_36=y
CONFIG_LV_FONT_MONTSERRAT_38=y
CONFIG_LV_FONT_MONTSERRAT_40=y
CONFIG_LV_FONT_MONTSERRAT_42=y
CONFIG_LV_FONT_MONTSERRAT_44=y
CONFIG_LV_FONT_FMT_TXT_LARGE=y
CONFIG_LV_USE_FONT_COMPRESSED=y
CONFIG_LV_USE_DEMO_BENCHMARK=y
CONFIG_IDF_EXPERIMENTAL_FEATURES=y
CONFIG_COMPILER_CXX_EXCEPTIONS=y
CONFIG_COMPILER_CXX_EXCEPTIONS_EMG_POOL_SIZE=0
CONFIG_I2C_SKIP_LEGACY_CONFLICT_CHECK=y
CONFIG_PTHREAD_TASK_STACK_SIZE_DEFAULT=16384
CONFIG_ESP_TASK_WDT_TIMEOUT_S=30
CONFIG_TASK_WDT_TIMEOUT_S=30
CONFIG_ESP_HOSTED_SDIO_GPIO_RESET_SLAVE=15
CONFIG_ESP_HOSTED_SDIO_PIN_CMD=13
CONFIG_ESP_HOSTED_SDIO_PIN_CLK=12
CONFIG_ESP_HOSTED_SDIO_PIN_D0=11
CONFIG_ESP_HOSTED_SDIO_PRIV_PIN_D1_4BIT_BUS=10
CONFIG_ESP_HOSTED_SDIO_PIN_D2=9
CONFIG_ESP_HOSTED_SDIO_PIN_D3=8
CONFIG_ESP_HOSTED_SDIO_PIN_D1=10
CONFIG_ESP_HOSTED_GPIO_SLAVE_RESET_SLAVE=15

# Use new IDF 5.3+ i2c_master API (not backward compat)
CONFIG_CODEC_I2C_BACKWARD_COMPATIBLE=n
CONFIG_LV_USE_IMGFONT=y
CONFIG_OTA_URL="https://api.tenclass.net/xiaozhi/ota/"

# Move mbedtls/TLS allocations to PSRAM so the TLS handshake to the xiaozhi
# cloud doesn't exhaust internal RAM (was causing esp-aes alloc failures and
# esp_hosted SDIO buffer crashes).
# CONFIG_MBEDTLS_INTERNAL_MEM_ALLOC is not set
CONFIG_MBEDTLS_EXTERNAL_MEM_ALLOC=y

# Fixed high app version (not git-describe). Two reasons:
#  1. ParseVersion() does std::stoi per dot-segment; a git version like
#     "V0.4-..." threw and aborted the device. "99.0.0" is clean numeric.
#  2. Keeps the OTA server from ever seeing a "newer" official firmware and
#     auto-flashing over this custom Tab5+xiaozhi build.
CONFIG_APP_PROJECT_VER_FROM_CONFIG=y
CONFIG_APP_PROJECT_VER="99.0.0"

# Enable local "你好小智" (wn9s) wake word model packed into the "model" SPIFFS
# partition at build time by esp-sr's CMakeLists.txt (movemodel.py).
CONFIG_SR_WN_WN9S_NIHAOXIAOZHI=y
CONFIG_MODEL_IN_FLASH=y

# Free DMA-capable internal RAM for esp_hosted SDIO + I2S audio DMA. The
# xiaozhi voice path crashed with "esp_dma_capable_malloc: Not enough heap"
# / "sdio_rx_get_buffer" once audio started streaming. Move WiFi/LWIP buffers
# to PSRAM and reserve more internal RAM for DMA-only allocations.
CONFIG_SPIRAM_TRY_ALLOCATE_WIFI_LWIP=y
# Reserve 128 KB internal RAM for DMA/internal-only allocations. The wake word
# AFE pipeline + I2S RX reconfig need DMA-capable internal RAM; 64 KB was too
# small and i2s_alloc_dma_desc / esp-aes DMA failed with a load-access-fault.
CONFIG_SPIRAM_MALLOC_RESERVE_INTERNAL=131072

# Keep RTC/LP-SRAM (0x5010_xxxx) OUT of the heap. Under memory pressure the
# WakeNet AFE inference task's stack/buffers spilled into RTC-RAM, which the
# ESP32-P4 SIMD/PIE vector instructions cannot access -> load access fault in
# dl_esp32p4_sr_pointwise_conv1d. Excluding it forces those allocations into
# regular SRAM/PSRAM that the vector unit can address.
# CONFIG_ESP_SYSTEM_ALLOW_RTC_FAST_MEM_AS_HEAP is not set
```
